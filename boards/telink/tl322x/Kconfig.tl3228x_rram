## boards/telink/tl322x/Kconfig.tl3228x_rram
```kconfig
# Copyright (c) 2024 Telink Semiconductor
# SPDX-License-Identifier: Apache-2.0

config BOARD_TL3228X_RRAM
	help
		Telink TL322X Platform with RRAM boot
```

## boards/telink/tl322x_dc/Kconfig.tl3228x_dc
```kconfig
# Copyright (c) 2025 Telink Semiconductor
# SPDX-License-Identifier: Apache-2.0

config BOARD_TL3228X_DC
	help
		Telink TL322X Dual Core Platform (D25F application core + N22 BLE controller)
```

## drivers/flash/Kconfig.rram
```kconfig
# Copyright (c) 2024 Telink Semiconductor
# SPDX-License-Identifier: Apache-2.0

config SOC_RRAM_TELINK_TLX
	bool "Telink TLx RRAM (NVM) driver"
	default y
	depends on DT_HAS_TELINK_TLX_RRAM_ENABLED
	select FLASH_HAS_PAGE_LAYOUT
	select FLASH_HAS_DRIVER_ENABLED
	help
	  Enables Telink TLx on-chip RRAM (Resistive RAM / NVM) driver.

	  RRAM is the on-chip non-volatile memory on TLx series MCUs.
	  Key differences from external SPI Flash:
	    - No physical erasure needed (direct overwrite)
	    - Minimum write granularity: 16 bytes
	    - Empty state: all zeros (0x00)
	    - Zero wear-leveling (byte-addressable overwrite)
```

## drivers/usb/udc/Kconfig.tl322x
```kconfig
# Copyright (c) 2026 Telink Semiconductor

# SPDX-License-Identifier: Apache-2.0

config UDC_TELINK_TLX
	bool "Telink TL322X USB device controller driver"
	default y
	depends on DT_HAS_TELINK_TL322X_USBD_ENABLED
	help
	  Telink TL322X USB device controller (UDC) driver for the new
	  USB device stack.

config UDC_TELINK_TLX_HIGH_SPEED
	bool "Enable USB high-speed mode"
	depends on UDC_TELINK_TLX
	help
	  Enable USB high-speed (480 Mbit/s) mode. USB requires HCLK of at
	  least 48 MHz, which corresponds to a CPU clock of 96 MHz or more.
	  When disabled, the controller operates in full-speed mode.

config UDC_TLX_MSG_QUEUE_SIZE
	int "TL322X UDC driver message queue size"
	depends on UDC_TELINK_TLX
	default 32
	help
	  Number of driver events that can be queued between the interrupt
	  handler and the driver thread.

config UDC_TLX_THREAD_STACK_SIZE
	int "TL322X UDC driver thread stack size"
	depends on UDC_TELINK_TLX
	default 1024
	help
	  Stack size of the dedicated thread used to process UDC events.
```

## dts/bindings/flash_controller/telink,tlx-rram.yaml
```yaml
# Copyright (c) 2024 Telink Semiconductor
# SPDX-License-Identifier: Apache-2.0

description: Telink TLx RRAM (NVM) Controller

compatible: "telink,tlx-rram"

include: flash-controller.yaml
```
