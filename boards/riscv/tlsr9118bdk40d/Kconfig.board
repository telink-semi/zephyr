## boards/riscv/tlsr9118bdk40d/Kconfig.board
```kconfig
# Copyright (c) 2024 Telink Semiconductor
# SPDX-License-Identifier: Apache-2.0

config BOARD_TLSR9118BDK40D
	bool "Telink W91 Platform, latest board hardware version 2.0/2.1"
	depends on SOC_RISCV_TELINK_W91

config BOARD_TLSR9118BDK40D_V1
	bool "Telink W91 Platform, board hardware version 1.0/1.1"
	depends on SOC_RISCV_TELINK_W91
```

## boards/riscv/tlsr9118bdk40d/tlsr9118bdk40d_defconfig
```kconfig
# Copyright (c) 2023 Telink Semiconductor
# SPDX-License-Identifier: Apache-2.0

CONFIG_SOC_SERIES_RISCV_TELINK_W91=y
CONFIG_SOC_RISCV_TELINK_W91=y
CONFIG_BOARD_TLSR9118BDK40D=y
CONFIG_GPIO=n
CONFIG_SYS_CLOCK_TICKS_PER_SEC=1000
CONFIG_UART_INTERRUPT_DRIVEN=n
CONFIG_SERIAL=n
CONFIG_CONSOLE=n
CONFIG_UART_CONSOLE=n
CONFIG_LOG=n
CONFIG_ASSERT=n

# IPC
CONFIG_IPC_SERVICE=y
CONFIG_IPC_SERVICE_ICMSG_BOND_NOTIFY_REPEAT_TO_MS=2
CONFIG_MBOX=y
CONFIG_MBOX_INIT_PRIORITY=10
CONFIG_SPSC_PBUF_CACHE_NEVER=y

# HW DSP options
CONFIG_TELINK_W91_HWDSP=n
```

## boards/riscv/tlsr9518adk80d/Kconfig.board
```kconfig
# Copyright (c) 2023 Telink Semiconductor
# SPDX-License-Identifier: Apache-2.0
choice
prompt "Board Selection"
default BOARD_TLSR9518ADK80D

config BOARD_TLSR9518ADK80D
	bool "Telink B91 Platform"
	depends on SOC_RISCV_TELINK_B91

config BOARD_TLSR9518ADK80D_USB_DONGLE
	bool "Telink B91 Platform with USB dongle layout"
	depends on SOC_RISCV_TELINK_B91

config BOARD_TLSR9518ADK80D_USB_DONGLE_RETENTION
	bool "Telink B91 Platform with USB dongle retention layout"
	depends on SOC_RISCV_TELINK_B91

config BOARD_TLSR9518ADK80D_MARS
	bool "Telink B91 Mars"
	depends on SOC_RISCV_TELINK_B91

config BOARD_TLSR9518ADK80D_MARS_RETENTION
	bool "Telink B91 Mars with retention"
	depends on SOC_RISCV_TELINK_B91

config BOARD_TLSR9518ADK80D_RETENTION
	bool "Telink B91 Platform with retention"
	depends on SOC_RISCV_TELINK_B91
endchoice

config BOARD_TLSR9X_NON_RETENTION_RAM_CODE
	bool "Place Telink RAM code into non retention memory"
	depends on SOC_SERIES_RISCV_TELINK_B9X && (BOARD_TLSR9518ADK80D_RETENTION \
		|| BOARD_TLSR9518ADK80D_MARS_RETENTION \
		|| BOARD_TLSR9518ADK80D_USB_DONGLE_RETENTION)
	help
		Place Telink RAM code into non retention memory and restore ram code on each boot.
```

## boards/riscv/tlsr9518adk80d/tlsr9518adk80d_mars_retention_defconfig
```kconfig
# Copyright (c) 2023 Telink Semiconductor
# SPDX-License-Identifier: Apache-2.0

CONFIG_SOC_SERIES_RISCV_TELINK_B9X=y
CONFIG_SOC_RISCV_TELINK_B91=y
CONFIG_BOARD_TLSR9518ADK80D_MARS_RETENTION=y
CONFIG_GPIO=y
CONFIG_SYS_CLOCK_TICKS_PER_SEC=1000
CONFIG_UART_INTERRUPT_DRIVEN=y
CONFIG_SERIAL=y
CONFIG_CONSOLE=y
CONFIG_UART_CONSOLE=y

# HW DSP options
CONFIG_TELINK_B9x_HWDSP=n

# SHT3XD
CONFIG_I2C=y
CONFIG_SENSOR=y

# WS2812
CONFIG_LED_STRIP=y
CONFIG_LED_STRIP_LOG_LEVEL_DBG=y
CONFIG_WS2812_STRIP=y
CONFIG_WS2812_STRIP_GPIO_TELINK=y

# DFU via USB
CONFIG_USB_DEVICE_STACK=y
CONFIG_USB_DEVICE_INITIALIZE_AT_BOOT=n
CONFIG_USB_CDC_ACM_LOG_LEVEL_OFF=y
```

## drivers/i2c/Kconfig.w91
```kconfig
# Copyright (c) 2021-2023 Telink Semiconductor
# SPDX-License-Identifier: Apache-2.0

config I2C_TELINK_W91
	bool "Telink Semiconductor W91 I2C driver"
	default y
	depends on DT_HAS_TELINK_W91_I2C_ENABLED
	help
	  Enables Telink W91 I2C driver.

if I2C_TELINK_W91

config I2C_TELINK_W91_IPC_RESPONSE_TIMEOUT_MS
	int "Telink IPC dispatcher timeout while waiting from the endpoint response"
	default 100
	help
		This option sets Telink IPC dispatcher response driver timeout in mS.

endif # I2C_TELINK_W91
```

## drivers/mbox/Kconfig.telink_w91
```kconfig
# Copyright (c) 2023 Telink Semiconductor
# SPDX-License-Identifier: Apache-2.0

config MBOX_TELINK_W91_IPC
	bool "Telink W91 Message Receive Unit (MRU) driver"
	default y
	depends on BOARD_TLSR9118BDK40D
	help
	  Driver for Telink W91 Message Receive Unit (MRU).
```

## drivers/nfc/Kconfig
```kconfig
#
# Copyright (c) 2023 Sendrato
#
# SPDX-License-Identifier: Apache-2.0
#

rsource "Kconfig.nt3h2x11"
rsource "Kconfig.nrfxnfc"
```

## drivers/nfc/Kconfig.nrfxnfc
```kconfig
#
# Copyright (c) 2023 Sendrato
#
# SPDX-License-Identifier: Apache-2.0
#

config NRFXNFC
    bool "nRFx-NFC driver"
    default n
    help
        Enable nRFx NFC driver.

if NRFXNFC

config NRFXNFC_DRV_NAME
    string "Device Tree name of nRFx-NFC driver"
    default "nRFxNFC"
    help
        Device Tree name of nRFx-NFC driver.

config NRFXNFC_T2T
    bool "Enable NFC Type 2 Tag library"
    default n
    select NFC_T2T_NRFXLIB

config NRFXNFC_T4T
    bool "Enable NFC Type 4 Tag library"
    default n
    select NFC_T4T_NRFXLIB

config NRFXNFC_INIT_PRIORITY
    int "NRFXNFC NFC driver init priority"
    default 75

config NRFXNFC_MAX_PAYLOAD_SIZE
    int "Max payload in bytes"
    default 988

rsource "nrfxnfc/Kconfig"

endif # NRFXNFC
```

## drivers/nfc/Kconfig.st25dvxxkc
```kconfig
#
# Copyright (c) 2023 Sendrato
#
# SPDX-License-Identifier: Apache-2.0
#

config ST25DVXXKC
    bool "ST25DVXXKC NFC driver"
    default n
    depends on I2C
    help
      Enable I2C-based driver for ST25DVXXKC driver.

if ST25DVXXKC

config NT3H2X11_2K
    bool "Use 2k memory map instead of 1k"
    default n
    help
      Use 2k memory map instead of 1k

config NT3H2X11_MAX_WRITE_DELAY
    int "delay in ms"
    default 10
    help
      Max I2C write delay in ms for when writing EEPROM

config ST25DVXXKC_INIT_PRIORITY
    int "ST25DVXXKC NFC driver init priority"
    default 75

module = ST25DVXXKC
module-str = st25xxdvkc
source "${ZEPHYR_BASE}/subsys/logging/Kconfig.template.log_config"

endif # ST25DVXXKC
```

## drivers/nfc/nrfxnfc/Kconfig
```kconfig
#
# Copyright (c) 2018 Nordic Semiconductor
#
# SPDX-License-Identifier: LicenseRef-Nordic-5-Clause
#

config NFC_T2T_NRFXLIB
    default y if NRFXNFC_T2T
	bool "Enable NFC Type 2 Tag library"

config NFC_T4T_NRFXLIB
    default y if NRFXNFC_T4T
	bool "Enable NFC Type 4 Tag library"

rsource "platform/Kconfig"
```

## drivers/spi/Kconfig.w91
```kconfig
# Copyright (c) 2024 Telink Semiconductor
# SPDX-License-Identifier: Apache-2.0

config SPI_TELINK_W91
	bool "Telink Semiconductor W91 SPI driver"
	default y
	depends on DT_HAS_TELINK_W91_SPI_ENABLED
	help
	  Enables Telink W91 SPI driver.

if SPI_TELINK_W91

config SPI_TELINK_W91_IPC_RESPONSE_TIMEOUT_MS
	int "Telink IPC dispatcher timeout while waiting from the endpoint response"
	default 10
	help
		This option sets Telink IPC dispatcher response driver timeout in mS.

config SPI_TELINK_W91_IPC_MASTER_RX_RESPONSE_TIMEOUT_MS
	int "Telink IPC dispatcher SPI Master RX timeout waiting for endpoint response"
	default 200
	help
		This option sets Telink IPC dispatcher master RX response timeout in mS.

endif # SPI_TELINK_W91
```

## dts/bindings/bluetooth/telink,b91-bt.yaml
```yaml
description: Telink B91 Bluetooth HCI node

compatible: "telink,b91-bt"

include: bt-hci.yaml

properties:
  bt-hci-name:
    default: "HCI Controller"
  bt-hci-bus:
    default: "BT_HCI_BUS_VIRTUAL"
  bt-hci-quirks:
    default: ["BT_HCI_QUIRK_NO_AUTO_DLE"]
```

## dts/bindings/i2c/telink,w91-i2c.yaml
```yaml
# Copyright (c) 2021-2023, Telink Semiconductor
# SPDX-License-Identifier: Apache-2.0

description: Telink W91 I2C

include: i2c-controller.yaml

compatible: "telink,w91-i2c"

properties:
  reg:
    required: false

  pinctrl-0:
    type: phandles
    required: true
```

## dts/bindings/mbox/telink,mbox-ipc-w91.yaml
```yaml
# Copyright (c) 2023 Telink Semiconductor (Shanghai) Co., Ltd.
# SPDX-License-Identifier: Apache-2.0

description: Telink W91 IPC (MBOX Interprocessor Communication)

compatible: "telink,mbox-ipc-w91"

include: [base.yaml, mailbox-controller.yaml]

properties:
  max-channels:
    type: int
    required: true
    description: Maximum number of channels

  sw-irq-pending:
    type: int
    required: true
    description: Address of the SW IRQ Pending register

  sw-irq-en:
    type: int
    required: true
    description: Address of the SW IRQ Enable register

  sw-irq-claim:
    type: int
    required: true
    description: Address of the SW IRQ Claim register

mbox-cells:
  - channel
```

## dts/bindings/nfc/nfc,st25dvxxkc.yaml
```yaml
#
# Copyright (c) 2023 Sendrato
#
# SPDX-License-Identifier: Apache-2.0
#

description: STM ST25DVXXKC IC

compatible: "stm,st25dvxxkc"

include: i2c-device.yaml

properties:
  irq-gpios:
    type: phandle-array
    required: false
    description: |
      The INT signal configuration is active-low.
```

## dts/bindings/spi/telink,w91-spi.yaml
```yaml
# Copyright (c) 2024, Telink Semiconductor
# SPDX-License-Identifier: Apache-2.0

description: Telink W91 SPI

include: spi-controller.yaml

compatible: "telink,w91-spi"

properties:

  # TODO: refactor pins accordingly

  pinctrl-0:
    type: phandles
    required: true

  cs0-pin:
    type: string
    required: true
    enum:
      - "0"
      - "LSPI_CSN_PE0_PIN"
      - "GPIO_PA1"
      - "GPIO_PB6"

  cs1-pin:
    type: string
    enum:
      - "0"
      - "LSPI_CSN_PE0_PIN"
      - "GPIO_PA1"
      - "GPIO_PB6"

  cs2-pin:
    type: string
    enum:
      - "0"
      - "LSPI_CSN_PE0_PIN"
      - "GPIO_PA1"
      - "GPIO_PB6"
```

## samples/boards/tlsr9x/timer/sample.yaml
```yaml
sample:
  name: TIMER usage sample
tests:
  sample.drivers.uart:
    tags: timer tim
    depends_on: gpio
    harness: tim_outs
```

## samples/subsys/ipc/ipc_service/icmsg/remote/boards/tlsr9118bdk40d.conf
```kconfig
CONFIG_MBOX_TELINK_W91_IPC=y
CONFIG_RV_BOOT_HART=1

CONFIG_PRINTK=n
CONFIG_LOG=n
CONFIG_ASSERT=n
```

## soc/riscv/riscv-privilege/telink_w91/Kconfig.n22
```kconfig
# Copyright (c) 2023 Telink Semiconductor
# SPDX-License-Identifier: Apache-2.0

config TELINK_W91_FETCH_N22_BIN
	bool "Fetch N22 binary after build"
	default y
	depends on SOC_SERIES_RISCV_TELINK_W91
	help
		This option fetching N22 binary after build.

config TELINK_W91_FETCH_N22_BIN_REVISION
	string "N22 binaries revision"
	default "24a60e998dc4ab986c147bcf2c910ba458198fab"
	depends on TELINK_W91_FETCH_N22_BIN
	help
		This option sets N22 binary revision.
```

## soc/telink/tlsr/tlsr951x/Kconfig.soc
```kconfig
# Copyright (c) 2021 Telink Semiconductor
# SPDX-License-Identifier: Apache-2.0

config SOC_SERIES_TLSR951X
	bool
	select SOC_FAMILY_TELINK_TLSR
	help
	  Telink TLSR951X

config SOC_TLSR9518
	bool
	select SOC_SERIES_TLSR951X
	help
	  Telink TLSR9518

config SOC_SERIES
	default "tlsr951x" if SOC_SERIES_TLSR951X

config SOC
	default "tlsr9518" if SOC_TLSR9518

config PM_DEVICE
	default y if PM

config TELINK_B91_REBOOT_ON_FAULT
	bool "Reboot system when fault happened"
	depends on SOC_SERIES_RISCV_TELINK_B91
	default n
	help
		This option enables Telink B91 chip reboot after fault.

config TELINK_B91_REBOOT_ON_FAULT_DELAY
	int "Reboot system delay in mS"
	depends on SOC_SERIES_RISCV_TELINK_B91 && TELINK_B91_REBOOT_ON_FAULT
	default 1000
	range 0 30000
	help
		This option sets Telink B91 chip reboot on fault delay in mS.
```

## subsys/nfc/Kconfig
```kconfig
#
# Copyright (c) 2023 Sendrato
#
# SPDX-License-Identifier: Apache-2.0
#

menu "NFC"

config NFC
  bool "NFC subsystem"
  default n
  help
    This option enables the NFC subsystem.

if NFC

rsource "ndef/Kconfig"
rsource "t2t/Kconfig"
rsource "t4t/Kconfig"
rsource "tnep/Kconfig"

endif # NFC

endmenu
```
