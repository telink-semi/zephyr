## prj.conf
```kconfig
# general project configuration
CONFIG_LOG=y
CONFIG_LOG_MODE_MINIMAL=y
CONFIG_NETWORKING=y
CONFIG_NET_L2_OPENTHREAD=y

# thread features
CONFIG_OPENTHREAD_THREAD_VERSION_1_4=y
CONFIG_OPENTHREAD_SLAAC=y
CONFIG_OPENTHREAD_DNS_CLIENT=y
CONFIG_OPENTHREAD_ECDSA=y
CONFIG_OPENTHREAD_SRP_CLIENT=y
CONFIG_OPENTHREAD_DEFAULT_TX_POWER=3

# kernel and stdlib heap
CONFIG_HEAP_MEM_POOL_SIZE=1024
CONFIG_COMMON_LIBC_MALLOC_ARENA_SIZE=2048

# enable power management
CONFIG_PM=y

# SED device with its poll interval
CONFIG_OPENTHREAD_MTD=y
CONFIG_OPENTHREAD_MTD_SED=y
CONFIG_OPENTHREAD_POLL_PERIOD=1000

# sync matter light-switch configurations
CONFIG_OPENTHREAD_SLAAC=y
CONFIG_OPENTHREAD_DNS_CLIENT=y
CONFIG_OPENTHREAD_ECDSA=y
CONFIG_OPENTHREAD_SRP_CLIENT=y
CONFIG_OPENTHREAD_DEFAULT_TX_POWER=3

# thread network credentials
CONFIG_OPENTHREAD_CHANNEL=14
CONFIG_OPENTHREAD_PANID=1419
CONFIG_OPENTHREAD_XPANID="11:11:11:11:22:22:44:44"
CONFIG_OPENTHREAD_NETWORKKEY="ff:ee:dd:cc:bb:aa:99:88:77:66:55:44:33:22:11:00"

# Use NVS as settings backend
CONFIG_NVS=y

# BLE && Thread coexistence
CONFIG_IEEE802154_TLX_BLE_COEXIST=n
CONFIG_DYNAMIC_INTERRUPTS=y

CONFIG_BT=y
CONFIG_LOG=y
CONFIG_BT_SMP=y
CONFIG_BT_PERIPHERAL=y
CONFIG_BT_DIS=y
CONFIG_BT_DIS_PNP=n
CONFIG_BT_DEVICE_NAME="Zephyr Health Thermometer"
CONFIG_BT_DEVICE_APPEARANCE=768
```

## src/main.c
```c
/* main.c - OpenThread */

/*
 * Copyright (c) 2023-2026 Telink
 *
 * SPDX-License-Identifier: Apache-2.0
 */

#include <zephyr/devicetree.h>
#include <zephyr/logging/log.h>
LOG_MODULE_REGISTER(ot_main, LOG_LEVEL_DBG);

#include <zephyr/net/openthread.h>
#include <openthread/thread.h>

static void ot_show_ip6_addr(otInstance *inst)
{
	const otNetifAddress *ip6_addr = otIp6GetUnicastAddresses(inst);

	for (const otNetifAddress *addr = ip6_addr; addr; addr = addr->mNext) {
		if (addr->mValid) {
			char ip6_str[OT_IP6_ADDRESS_STRING_SIZE];

			otIp6AddressToString(&addr->mAddress, ip6_str, sizeof(ip6_str));
			LOG_INF("ip: %s", ip6_str);
		}
	}
}

static void ot_satate_changed(otChangedFlags flags,
	struct openthread_context *ot_context, void *user_data)
{
	if (flags & OT_CHANGED_THREAD_ROLE) {
		switch (otThreadGetDeviceRole(ot_context->instance)) {
		case OT_DEVICE_ROLE_CHILD:
			LOG_INF("OT child");
			LOG_INF("OT Short address: %04x",
				otLinkGetShortAddress(ot_context->instance));
			LOG_HEXDUMP_INF(otLinkGetExtendedAddress(ot_context->instance),
				OT_EXT_ADDRESS_SIZE, "OT Extended address:");
			ot_show_ip6_addr(ot_context->instance);
			break;
		case OT_DEVICE_ROLE_ROUTER:
			LOG_INF("OT router");
			LOG_INF("OT Short address: %04x",
				otLinkGetShortAddress(ot_context->instance));
			LOG_HEXDUMP_INF(otLinkGetExtendedAddress(ot_context->instance),
				OT_EXT_ADDRESS_SIZE, "OT Extended address:");
			ot_show_ip6_addr(ot_context->instance);
			break;
		case OT_DEVICE_ROLE_LEADER:
			LOG_INF("OT leader");
			LOG_INF("OT Short address: %04x",
				otLinkGetShortAddress(ot_context->instance));
			LOG_HEXDUMP_INF(otLinkGetExtendedAddress(ot_context->instance),
				OT_EXT_ADDRESS_SIZE, "OT Extended address:");
			ot_show_ip6_addr(ot_context->instance);
			break;
		case OT_DEVICE_ROLE_DISABLED:
			LOG_INF("OT disabled");
			break;
		case OT_DEVICE_ROLE_DETACHED:
			LOG_INF("OT detached");
			break;
		default:
			LOG_INF("OT unknown");
			break;
		}
	}
}

int main(void)
{
	// LOG_INF("***** OpenThread SED joiner @ F_CPU = %u *****",
	// 	(DT_PROP(DT_PATH(cpus, cpu_0), clock_frequency)));
	// LOG_INF("OT channel     %u",     CONFIG_OPENTHREAD_CHANNEL);
	// LOG_INF("OT pan id      %04x",   CONFIG_OPENTHREAD_PANID);
	// LOG_INF("OT pan ext id  %s",     CONFIG_OPENTHREAD_XPANID);
	// LOG_INF("OT network key %s",     CONFIG_OPENTHREAD_NETWORKKEY);
	LOG_INF("***** OpenThread + BLE Peripheral *****");

	static struct openthread_state_changed_cb ot_state_cahnge = {
		.state_changed_cb = ot_satate_changed
	};

	openthread_state_changed_cb_register(openthread_get_default_context(), &ot_state_cahnge);

#ifdef CONFIG_IEEE802154_TLX_BLE_COEXIST
	extern void bt_le_task_init(void);
	bt_le_task_init();
#endif

	/* Main loop: simulate sensor data and send BLE notifications */
	while (1) {
		k_sleep(K_SECONDS(1));
	}

	return 0;
}
```

## src/le_task.c
```c
/*
 * Copyright (c) 2023-2026 Telink
 *
 * SPDX-License-Identifier: Apache-2.0
 */

#include <zephyr/bluetooth/bluetooth.h>
#include <zephyr/bluetooth/hci.h>
#include <zephyr/bluetooth/conn.h>
#include <zephyr/bluetooth/uuid.h>
#include <zephyr/bluetooth/gatt.h>
#include <zephyr/settings/settings.h>

#include <zephyr/logging/log.h>
LOG_MODULE_REGISTER(ot_ble_le_task, LOG_LEVEL_INF);

#include "thd_task.h"

/* Channel Sounding RAS Reflector integration */
#define BT_UUID_RAS_SERVICE_VAL 0x185B

#if CONFIG_BT_TLX_CHANNEL_SOUNDING
extern void cs_reflector_init(void);
extern void cs_reflector_on_connected(struct bt_conn *conn, uint8_t err);
extern void cs_reflector_on_disconnected(struct bt_conn *conn);
#endif

/* ============================================================
 * BLE Peripheral section
 * ============================================================
 */

static const struct bt_data ad[] = {
	BT_DATA_BYTES(BT_DATA_FLAGS, (BT_LE_AD_GENERAL | BT_LE_AD_NO_BREDR)),
	BT_DATA_BYTES(BT_DATA_UUID16_SOME, BT_UUID_RAS_SERVICE_VAL & 0xFF,
		      (BT_UUID_RAS_SERVICE_VAL >> 8) & 0xFF),
};

static const struct bt_data sd[] = {
	BT_DATA(BT_DATA_NAME_COMPLETE, CONFIG_BT_DEVICE_NAME, sizeof(CONFIG_BT_DEVICE_NAME) - 1),
};

static void connected(struct bt_conn *conn, uint8_t err)
{
	if (err) {
		printk("Connection failed, err 0x%02x %s\n", err, bt_hci_err_to_str(err));
	} else {
		printk("Connected\n");
	}
#if CONFIG_BT_TLX_CHANNEL_SOUNDING
	cs_reflector_on_connected(conn, err);
#endif
}

static void disconnected(struct bt_conn *conn, uint8_t reason)
{
	printk("Disconnected, reason 0x%02x %s\n", reason, bt_hci_err_to_str(reason));
#if CONFIG_BT_TLX_CHANNEL_SOUNDING
	cs_reflector_on_disconnected(conn);
#endif
}

BT_CONN_CB_DEFINE(conn_callbacks) = {
	.connected = connected,
	.disconnected = disconnected,
};

static void bt_ready(void)
{
	int err = 0;

	printk("Bluetooth initialized\n");

	err = bt_le_adv_start(BT_LE_ADV_CONN_FAST_1, ad, ARRAY_SIZE(ad), sd, ARRAY_SIZE(sd));
	if (err) {
		printk("Advertising failed to start (err %d)\n", err);
		return;
	}

	printk("Advertising successfully started\n");
}

/*
 * static void auth_cancel(struct bt_conn *conn)
 * {
 *	char addr[BT_ADDR_LE_STR_LEN];
 *
 *	bt_addr_le_to_str(bt_conn_get_dst(conn), addr, sizeof(addr));
 *
 *	printk("Pairing cancelled: %s\n", addr);
 * }
 *
 * static struct bt_conn_auth_cb auth_cb_display = {
 *	.cancel = auth_cancel,
 * }
 */

void bt_le_task_init(void)
{
	int err;

	err = bt_enable(NULL);
	if (err) {
		printk("Bluetooth init failed (err %d)\n", err);
		return;
	}

	/* Load bonded keys from flash so reconnects skip re-pairing. */
	if (IS_ENABLED(CONFIG_SETTINGS)) {
		settings_load();
	}
#if CONFIG_BT_TLX_CHANNEL_SOUNDING
	/* Initialize Channel Sounding RAS Reflector */
	cs_reflector_init();
#endif
	bt_ready();

	/* bt_conn_auth_cb_register(&auth_cb_display); */

	while (1) {
		k_sleep(K_SECONDS(1));
		static int i;

		if (i == 0) {
			i = 1;
			// extern struct k_sem controller_sem;
			/* tlksdk_thd_enableFlexibleTask(THD_TASK_ENABLE); */
			tlksdk_thd_enableInsertTask1(0x01);
			// k_sem_give(&controller_sem);
		}
	}
}
```
