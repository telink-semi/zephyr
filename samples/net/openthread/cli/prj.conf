## prj.conf
```kconfig
CONFIG_NETWORKING=y
CONFIG_NET_L2_OPENTHREAD=y

CONFIG_NET_PKT_RX_COUNT=8
CONFIG_NET_PKT_TX_COUNT=8

# thread network sed
CONFIG_OPENTHREAD_MTD=y
CONFIG_OPENTHREAD_MTD_SED=y
CONFIG_OPENTHREAD_POLL_PERIOD=1000
CONFIG_OPENTHREAD_NUM_MESSAGE_BUFFERS=64

# disable console
CONFIG_LOG=y
CONFIG_LOG_PROCESS_THREAD_STACK_SIZE=4096
CONFIG_SHELL=n
CONFIG_OPENTHREAD_MANUAL_START=n

# power saving
CONFIG_PM=y

# thread network credentials
CONFIG_OPENTHREAD_CHANNEL=26
CONFIG_OPENTHREAD_PANID=1234
CONFIG_OPENTHREAD_XPANID="ff:0d:b8:ff:ff:ff:ff:01"
CONFIG_OPENTHREAD_NETWORKKEY="ff:ee:dd:cc:bb:aa:99:88:77:66:55:44:33:22:11:00"

CONFIG_TRACING=y
CONFIG_TRACING_USER=y
```

## overlay-cli.conf
```kconfig
# This overlay switches from NCP to RCP, use in combination with prj.conf

CONFIG_OPENTHREAD_COPROCESSOR_NCP=n
CONFIG_OPENTHREAD_COPROCESSOR_RCP=n

CONFIG_NET_PKT_RX_COUNT=8
CONFIG_NET_PKT_TX_COUNT=8
```

## boards/tlsr9258a.conf
```kconfig
# usb
CONFIG_USB_DEVICE_STACK=y
CONFIG_USB_DEVICE_INITIALIZE_AT_BOOT=n

# Telink relative thread features
CONFIG_NET_PKT_TXTIME=y
CONFIG_NET_PKT_TIMESTAMP=y
CONFIG_IEEE802154_TELINK_B9X_ENCRYPTION=y
CONFIG_OPENTHREAD_NUM_MESSAGE_BUFFERS=350
CONFIG_TELINK_B9X_MBEDTLS_HW_ACCELERATION=n
```

## boards/tlsr9528a.conf
```kconfig
# usb
CONFIG_USB_DEVICE_STACK=y
CONFIG_USB_DEVICE_INITIALIZE_AT_BOOT=n

# Telink relative thread features
CONFIG_NET_PKT_TXTIME=y
CONFIG_NET_PKT_TIMESTAMP=y
CONFIG_IEEE802154_TELINK_B9X_ENCRYPTION=y
CONFIG_OPENTHREAD_NUM_MESSAGE_BUFFERS=350
```

## boards/tlsr9258a.overlay
```dts
/*
 * Copyright (c) 2023 Telink Semiconductor
 *
 * SPDX-License-Identifier: Apache-2.0
 */

/ {
	chosen {
		zephyr,shell-uart = &uart0;
	};
};
```

## boards/tlsr9518adk80d.overlay
```dts
/*
 * Copyright (c) 2021 Telink Semiconductor
 *
 * SPDX-License-Identifier: Apache-2.0
 */

/ {
	chosen {
		zephyr,ot-uart = &uart0;
		zephyr,console = &uart0;
	};
};
```

## src/main.c
```c
/* main.c - OpenThread */

/*
 * Copyright (c) 2023 Telink
 *
 * SPDX-License-Identifier: Apache-2.0
 */

#include <zephyr/logging/log.h>
LOG_MODULE_REGISTER(ot_main, LOG_LEVEL_DBG);

#include <zephyr/net/openthread.h>
#include <openthread/thread.h>

#ifdef CONFIG_USB_DEVICE_STACK
#include <zephyr/usb/usb_device.h>
#endif /* CONFIG_USB_DEVICE_STACK */

static void ot_satate_changed(otChangedFlags flags,
	struct openthread_context *ot_context, void *user_data)
{
	if (flags & OT_CHANGED_THREAD_ROLE) {
		switch (otThreadGetDeviceRole(ot_context->instance)) {
		case OT_DEVICE_ROLE_CHILD:
			LOG_INF("OT child");
			LOG_INF("OT Short address: %04x",
				otLinkGetShortAddress(ot_context->instance));
			LOG_HEXDUMP_INF(otLinkGetExtendedAddress(ot_context->instance),
				OT_EXT_ADDRESS_SIZE, "OT Extended address:");
			break;
		case OT_DEVICE_ROLE_ROUTER:
			LOG_INF("OT router");
			LOG_INF("OT Short address: %04x",
				otLinkGetShortAddress(ot_context->instance));
			LOG_HEXDUMP_INF(otLinkGetExtendedAddress(ot_context->instance),
				OT_EXT_ADDRESS_SIZE, "OT Extended address:");
			break;
		case OT_DEVICE_ROLE_LEADER:
			LOG_INF("OT leader");
			LOG_INF("OT Short address: %04x",
				otLinkGetShortAddress(ot_context->instance));
			LOG_HEXDUMP_INF(otLinkGetExtendedAddress(ot_context->instance),
				OT_EXT_ADDRESS_SIZE, "OT Extended address:");
			break;
		case OT_DEVICE_ROLE_DISABLED:
			LOG_INF("OT disabled");
			break;
		case OT_DEVICE_ROLE_DETACHED:
			LOG_INF("OT detached");
			break;
		default:
			LOG_INF("OT unknown");
			break;
		}
	}
}

int main(void)
{
#ifdef CONFIG_USB_DEVICE_STACK
	usb_enable(NULL);
#endif /* CONFIG_USB_DEVICE_STACK */
	LOG_INF("***** OpenThread CLI on Zephyr *****");
#ifndef CONFIG_OPENTHREAD_MANUAL_START
	LOG_INF("OT channel     %u",     CONFIG_OPENTHREAD_CHANNEL);
	LOG_INF("OT pan id      %04x",   CONFIG_OPENTHREAD_PANID);
	LOG_INF("OT pan ext id  %s",     CONFIG_OPENTHREAD_XPANID);
	LOG_INF("OT network key %s",     CONFIG_OPENTHREAD_NETWORKKEY);
#endif /* CONFIG_OPENTHREAD_MANUAL_START */
	static struct openthread_state_changed_cb ot_state_cahnge = {
		.state_changed_cb = ot_satate_changed
	};

	openthread_state_changed_cb_register(openthread_get_default_context(), &ot_state_cahnge);

	return 0;
}
```
