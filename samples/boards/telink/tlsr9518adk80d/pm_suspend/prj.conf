## CMakeLists.txt
```
# SPDX-License-Identifier: Apache-2.0

cmake_minimum_required(VERSION 3.20.0)
find_package(Zephyr REQUIRED HINTS $ENV{ZEPHYR_BASE})
project(telink_suspend)

target_sources(app PRIVATE src/main.c)
```

## Kconfig
```
# Copyright (c) 2022 Telink Semiconductor Inc.
# SPDX-License-Identifier: Apache-2.0

mainmenu "Telink Suspend Demo"

config APP_RETENTION
	bool "State retention in system off"
	help
	  On some Telink chips this application supports retaining
	  memory while in system off.  Select this to enable the
	  feature.

source "Kconfig.zephyr"
```

## sample.yaml
```
sample:
  name: Low Power State Sample for Telink B91 Series
common:
  tags: power
tests:
  sample.boards.telink.tlsr9518adk80d.pm_suspend:
    build_only: true
    platform_allow: tlsr9518adk80d
```

## prj.conf
```kconfig
CONFIG_PM=y
# Required to disable default behavior of deep sleep on timeout
CONFIG_PM_DEVICE=y
CONFIG_GPIO=y
# Optional select RAM retention
#CONFIG_APP_RETENTION=y
```

## src/main.c
```c
/*
 * Copyright (c) 2022 Telink Semiconductor
 *
 * SPDX-License-Identifier: Apache-2.0
 */

#include <stdio.h>
#include <zephyr.h>

#define SLEEP_S 2U

#define STACK_SIZE 500
#define PRIORITY 5

void entry_point(int unused1, int unused2, int unused3)
{
	while (1) {
		printk("System time: %lli ms\n", k_uptime_get());
		printk("Sleeping %u s\n", SLEEP_S);
		k_sleep(K_SECONDS(SLEEP_S));
		printk("WakeUp system time: %lli ms\n", k_uptime_get());
	}
}


K_THREAD_DEFINE(tid, STACK_SIZE,
		entry_point, NULL, NULL, NULL,
		PRIORITY, 0, 0);
```
